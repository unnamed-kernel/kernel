## src/arch/Kconfig
```kconfig
choice
    prompt "Architecture"
    default ARCH_X86-64

config ARCH_X86-64
    bool "x86 (64-bit) architecture"

endchoice

source "src/arch/x86_64/Kconfig"
```

## src/arch/x86_64/Kconfig
```kconfig
menu "Devices"
    visible if ARCH_X86-64

    config SERIAL_PORT
        int "Serial port"
        default 1
        help
          This is the serial port that the kernel will use for console
          output.
endmenu
```

## src/kernel/Kconfig
```kconfig
menu "Kernel tweak"
    config SCHED_QUANTUM
        int "Scheduler quantum"
            default "10"
            help 
                Number of ticks to schedule a process.
                The smaller the value, the more likely a process will be preempted.
    choice KERNEL_ALLOC
        prompt "Kernel Allocator"
        default ALLOC_LIBALLOC
        help
            Allocator to use for kernel memory.
            The liballoc allocator is the default.
        
        config ALLOC_LIBALLOC
            bool "Liballoc"
            help
                Use the liballoc as the kernel allocator.
    endchoice
    

endmenu
```

## src/loader/Kconfig
```kconfig
menu "Bootloader"
    choice
        prompt "Bootloader to use"
        default LOADER_LIMINE
        help 
            Select the bootloader to use.
            The default is limine.

        config LOADER_LIMINE
            bool "Limine"
            depends on ARCH_X86-64
            help
                Use limine as bootloader.
    endchoice

    config LOADER_EFI
        bool "EFI"
        depends on LOADER_LIMINE
        default y
endmenu
```
